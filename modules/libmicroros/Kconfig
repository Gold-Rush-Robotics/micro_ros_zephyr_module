## modules/libmicroros/Kconfig
```kconfig
menuconfig MICROROS
    bool
	default n
    prompt "micro-ROS Support"
    select APP_LINK_WITH_MICROROS
    help
        Enables a micro-ROS library

if MICROROS
    config APP_LINK_WITH_MICROROS
        bool "Link 'app' with MICROROS"
        default n
        help
            Add MICROROS header files to the 'app' include path. 
   
    choice
        prompt "micro-ROS transport"
        
        config MICROROS_TRANSPORT_CANFD
            bool "micro-ROS canfd transport"
            select CAN
        
    endchoice

    if MICROROS_TRANSPORT_CANFD

        config CAN_FD_MODE
            bool "CAN-FD"
            default y
            depends on CAN_HAS_CANFD && CAN
            help
                Enable CAN-FD compatible API
        config CANFD_MAX_DLC
            int "Max data length code in CAN frames"
            range 8 15
            default 15
            depends on CAN_FD_MODE && CAN
            help
                Maximum allowed DLC in a CAN frame. This parameter sets the
                data buffer size in a CAN frame and is therefore only used to
                optimize memory consumption.
        config CAN_HAS_CANFD
            bool
            depends on CAN
            help
                driver supports CAN-FD
        config CAN_TX_QUEUE_SIZE
            int "Maximum number of CAN frames to enqueue"
            default 3
            range 1 3
            help
	            Maximum number of CAN frames to enqueue for transmission.

        config CANFD_BITRATE_DATA
            int "Max bitrate for canfd"
            default 1000000
            range 50000 5000000

        config CANFD_BITRATE
            int "Max dbitrate for canfd"
            default 2000000
            range 50000 8000000

        
    endif
    config MICROROS_NODES
        string "available micro-ROS nodes"
        default "1"

    config MICROROS_PUBLISHERS
        string "available micro-ROS publishers"
        default "1"
    
    config MICROROS_SUBSCRIBERS
        string "available micro-ROS subscribers"
        default "1"

    config MICROROS_CLIENTS
        string "available micro-ROS service clients"
        default "1"

    config MICROROS_SERVERS
        string "available micro-ROS service servers"
        default "1"
        
    config MICROROS_RMW_HISTORIC
        string "available micro-ROS RMW historic memory"
        default "4"
    
    config MICROROS_XRCE_DDS_MTU
        string "micro-ROS transport MTU"
        default "512"
        
    config MICROROS_XRCE_DDS_HISTORIC
        string "micro-ROS middleware memory slots"
        default "4"  
endif
```
