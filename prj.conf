## prj.conf
```kconfig
CONFIG_GPIO=y
CONFIG_SERIAL=y
CONFIG_CAN=y
CONFIG_SPI=n
CONFIG_MICROROS=y

CONFIG_POLL=y
CONFIG_CAN_INIT_PRIORITY=80
CONFIG_CAN_MAX_FILTER=5

CONFIG_CAN_STATS=y

CONFIG_MAIN_STACK_SIZE=100000
CONFIG_LOG_DEFAULT_LEVEL=4
CONFIG_KERNEL_LOG_LEVEL_INF=y
# CONFIG_MICROROS_TRANSPORT_CANFD=y
CONFIG_CAN_FD_MODE=y
CONFIG_CANFD_MAX_DLC=15
CONFIG_CAN_TX_QUEUE_SIZE=3
CONFIG_CANFD_BITRATE=1000000
CONFIG_CANFD_BITRATE_DATA=2000000


CONFIG_NEWLIB_LIBC=y
CONFIG_NEWLIB_LIBC_NANO=y
CONFIG_PTHREAD_IPC=n

CONFIG_POSIX_API=y
CONFIG_POSIX_CLOCK=y

CONFIG_STDOUT_CONSOLE=y
CONFIG_UART_CONSOLE=y
CONFIG_LOG=y
CONFIG_LOG_BUFFER_SIZE=1024
CONFIG_RAM_CONSOLE=y
# CONFIG_HEAP_MEM_POOL_SIZE = 4096
# CONFIG_HEAP_MEM_POOL_SIZE=32768
CONFIG_LOG_MODE_OVERFLOW=y
CONFIG_LOG_BACKEND_UART=y
CONFIG_LOG_FRONTEND=n
CONFIG_CONSOLE=y

CONFIG_USB_DEVICE_STACK=y
CONFIG_USB_DEVICE_PRODUCT="Teensy"
CONFIG_USB_DEVICE_VID=4440

CONFIG_UART_LINE_CTRL=y
CONFIG_STATIC_INIT_GNU=y
CONFIG_BOOT_BANNER=n
CONFIG_DEBUG=y
# CONFIG_GPIO=y
# CONFIG_MICROROS=y

# CONFIG_MAIN_STACK_SIZE=25000
# CONFIG_MAIN_THREAD_PRIORITY=3

# CONFIG_NEWLIB_LIBC=y
# CONFIG_NEWLIB_LIBC_NANO=n
# CONFIG_PTHREAD_IPC=n

# CONFIG_POSIX_API=y
# CONFIG_POSIX_CLOCK=y

# CONFIG_STDOUT_CONSOLE=y
# CONFIG_LOG=y
# CONFIG_CAN=y
# CONFIG_UART_LINE_CTRL=y
```

## app.overlay
```dts
/{
chosen{
	zephyr,memory-region=&ocram;
	zephyr,sram=&ocram2;
	zephyr,canbus = &flexcan3;
	zephyr,console = &lpuart6; /* Teensy Pins 0(RX1) 1(TX1) */
};
};
&lpuart6 {
	status = "okay";
	current-speed = < 115200 >;
};
&flexcan3 {
	status = "okay";
};
```

## src/main.c
```c
#include <version.h>

#if ZEPHYR_VERSION_CODE >= ZEPHYR_VERSION(3,1,0)
#include <zephyr/kernel.h>
#include <zephyr/drivers/can.h>
#include <zephyr/device.h>
#include <zephyr/devicetree.h>
#include <zephyr/drivers/gpio.h>
#include <zephyr/posix/time.h>
#include <zephyr/linker/devicetree_regions.h>
#include <zephyr/logging/log.h>


#else
#include <zephyr.h>
#include <device.h>
#include <devicetree.h>
#include <drivers/gpio.h>
#include <posix/time.h>
#endif

#include <rcl/rcl.h>
#include <rcl/error_handling.h>
#include <std_msgs/msg/int32.h>

#include <rclc/rclc.h>
#include <rclc/executor.h>

#include <rmw_microros/rmw_microros.h>
#include <microros_transports.h>

#define RCCHECK(fn) { rcl_ret_t temp_rc = fn; if((temp_rc != RCL_RET_OK)){printf("Failed status on line %d: %d. Aborting.\n",__LINE__,(int)temp_rc);for(;;){};}}
#define RCSOFTCHECK(fn) { rcl_ret_t temp_rc = fn; if((temp_rc != RCL_RET_OK)){printf("Failed status on line %d: %d. Continuing.\n",__LINE__,(int)temp_rc);}}
// LOG_MODULE_REGISTER(microros_module);

LOG_MODULE_DECLARE(microros_module);


rcl_publisher_t publisher;
std_msgs__msg__Int32 msg;

void timer_callback(rcl_timer_t * timer, int64_t last_call_time)
{
	RCLC_UNUSED(last_call_time);
	if (timer != NULL) {
		RCCHECK(rcl_publish(&publisher, &msg, NULL));
		msg.data++;
	}
}

int main(void)
{
	rmw_uros_set_custom_transport(
		MICRO_ROS_FRAMING_REQUIRED,
		(void *) &default_params,
		zephyr_transport_open,
		zephyr_transport_close,
		zephyr_transport_write,
		zephyr_transport_read
	);

	rcl_allocator_t allocator = rcl_get_default_allocator();
	rclc_support_t support;

	// create init_options
	printf("0 \n");
	RCCHECK(rclc_support_init(&support, 0, NULL, &allocator));
	printf("1");

	// create node
	rcl_node_t node;
	rclc_node_init_default(&node, "zephyr_int32_publisher", "", &support)
	;

	// create publisher
	RCCHECK(rclc_publisher_init_default(
		&publisher,
		&node,
		ROSIDL_GET_MSG_TYPE_SUPPORT(std_msgs, msg, Int32),
		"zephyr_int32_publisher"));
	printf("2");

	// create timer,
	rcl_timer_t timer;
	const unsigned int timer_timeout = 1000;
	RCCHECK(rclc_timer_init_default(
		&timer,
		&support,
		RCL_MS_TO_NS(timer_timeout),
		timer_callback));
	printf("3");

	// create executor
	rclc_executor_t executor;
	RCCHECK(rclc_executor_init(&executor, &support.context, 1, &allocator));
	RCCHECK(rclc_executor_add_timer(&executor, &timer));

	printf("4");

	msg.data = 0;

	while(1){
		printf("5");
		rclc_executor_spin_some(&executor, 100);
		usleep(100000);
	}
	printf("5");

	// free resources
	RCCHECK(rcl_publisher_fini(&publisher, &node))
	RCCHECK(rcl_node_fini(&node))
return 0;
}
```
